## drivers/rtx/rtc/Kconfig
```kconfig
if I2C

menu "EFM32 RTC drivers"

config RTC_DRV_EFM32_BISHOP
	tristate "FEM32 for BISHOP"
	help
      If you say yes here you will get support for the
      RTC of EFM32 BISHOP series.

config RTC_DRV_EFM32_A6
	tristate "FEM32 for A6"
	help
      If you say yes here you will get support for the
      RTC of EFM32 A6 series.

config RTC_DRV_EFM32_Q7
	tristate "FEM32 for Q7"
	help
      If you say yes here you will get support for the
      RTC of EFM32 Q7 series.

config RTC_DRV_EFM32_PICO
	tristate "FEM32 for PICO"
	help
      If you say yes here you will get support for the
      RTC of EFM32 PICO series.

config RTC_DRV_EFM32_ADLINK
	tristate "FEM32 for ADLINK"
	help
      If you say yes here you will get support for the
      RTC of EFM32 ADLINK series.c

config RTC_DRV_EFM32_CSE
	tristate "FEM32 for CSE"
	help
      If you say yes here you will get support for the
      RTC of EFM32 CSE series.c
endmenu

endif
```

## kernel/kernel-4.9/drivers/rtx/Kconfig
```kconfig
menuconfig RTX
	bool "Retronix Hardware Support"
	help
	  Say Y here if you want to use the Retronix hardware.

if RTX

source "drivers/rtx/rtc/Kconfig"

endif
```

## kernel/kernel-4.9/drivers/rtx/rtc/Kconfig
```kconfig
if I2C

menu "EFM32 RTC drivers"

config RTC_DRV_EFM32_AVA_XV1
	tristate "FEM32 for AVA XV1"
	help
      If you say yes here you will get support for the
      RTC of EFM32 AVA XV1 series.
endmenu

endif
```
